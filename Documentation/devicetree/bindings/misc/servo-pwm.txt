## Documentation/devicetree/bindings/misc/servo-pwm.txt
```
LED connected to PWM

Required properties:
- compatible : should be "servo-pwm".

Each servo is represented as a servo-pwm device.

Servo properties:
- pwms : PWM property to point to the PWM device (phandle)/port (id) and to
  specify the period time to be used: <&phandle id period_ns>;
- duty-0 : (optional) [default 500000] duty cycle to set the servo motor at
  0 degrees, useful to compensate for devices drift.
- duty-180 : (optional) [default 2500000] duty cycle to set the servo motor at
  90 degrees, useful to compensate for devices drift.
- angle : (optional) [defaul 0] set the starting angle at driver loading.

Example:

pwm: pwm@0 {
	compatible = "pwm-gpio";
	pwm-gpio = <&pio 6 3 GPIO_ACTIVE_LOW>;
};

servo: servo@0 {
	compatible = "servo-pwm";
	pwms = <&pwm 0 2000000>;
	duty-0 = <60000>;
	duty-180 = <260000>;
	angle = <90>;
};
```

## Documentation/devicetree/bindings/misc/servo-pwm.yaml
```yaml
# SPDX-License-Identifier: (GPL-2.0-only OR BSD-2-Clause)
%YAML 1.2
---
$id: http://devicetree.org/schemas/misc/servo-pwm.yaml#
$schema: http://devicetree.org/meta-schemas/core.yaml#

title: Servo motor connected to PWM

maintainers:
  - Angelo Compagnucci <angelo@amarulasolutions.com>

description:
  Each servo is represented as a servo-pwm device.
  The 20ms period is the accepted standard and so most of the motors
  support it, while the duty cycle to be at min/max positions or how
  many degrees the motor can move varies a lot between manufacturers.
  The most common type of servo (SG90) has 180 degrees and moves
  between 0.5ms and 2.5ms duty cycle.

properties:
  compatible:
    const: servo-pwm

patternProperties:
  properties:
    pwms:
      maxItems: 1

    pwm-names: true

    degrees:
      description:
        How many degrees the motor can move.
      $ref: /schemas/types.yaml#/definitions/uint32

    duty-min:
      description:
        Duty cycle for position the motor at 0 degrees.
      $ref: /schemas/types.yaml#/definitions/uint32

    duty-max:
      description:
        Duty cycle for positioning the motor at "degrees" angle.
      $ref: /schemas/types.yaml#/definitions/uint32

additionalProperties: false

examples:
  - |

    servo: servo@0 {
      compatible = "servo-pwm";
      pwms = <&pwm 0 20000000 0>;
      degrees = <180>;
      duty-min = <500000>;
      duty-max = <2500000>;
    };

...
```
